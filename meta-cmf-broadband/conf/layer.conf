## meta-cmf-broadband/conf/layer.conf
```bitbake
BBPATH .= ":${LAYERDIR}"
BBFILES += "\
            ${LAYERDIR}/recipes-*/*/*.bb \
            ${LAYERDIR}/recipes-*/*/*.bbappend \
           "

BBFILE_COLLECTIONS += "cmf-broadband"
BBFILE_PATTERN_cmf-broadband := "^${LAYERDIR}/"
#BBFILE_PRIORITY_cmf-broadband = "24"

# do not error out on bbappends for missing recipes (mysql5)
#BB_DANGLINGAPPENDS_WARNONLY = "true"

LAYERDEPENDS_cmf-broadband = "rdk-broadband"

require conf/include/rdk-bbmasks-broadband.inc

LAYERSERIES_COMPAT_cmf-broadband = " dunfell kirkstone"

FEATURE_WANMANAGER_IPOE_MASK = ""
FEATURE_WANMANAGER_JSONHAL_MASK = ""
FEATURE_WANMANAGER_GPON_MASK = ""
FEATURE_WANMANAGER_DSL_MASK = ""
FEATURE_WANMANAGER_WAN_MASK = ""
FEATURE_WANMANAGER_VOICEMGR_MASK = ""
FEATURE_WANMANAGER_VLAN_MASK = ""
FEATURE_WANMANAGER_PPP_MASK = ""
FEATURE_WANMANAGER_FWUPGRADE_MASK = ""
FEATURE_CELLULAR_MANAGER_MASK = ""
FEATURE_RDKB_INTER_DEVICE_MANAGER = ""
FEATURE_RDKB_LED_MANAGER = ""
```

## meta-cmf-filogic/conf/layer.conf
```bitbake
# We have a conf and classes directory, add to BBPATH
BBPATH .= ":${LAYERDIR}"

# We have a recipes-* directories, add to BBFILES
BBFILES += "${LAYERDIR}/recipes-*/*/*.bb \
	${LAYERDIR}/recipes-*/*/*.bbappend"

BBFILE_COLLECTIONS += "cmf-filogic"
BBFILE_PATTERN_cmf-filogic = "^${LAYERDIR}/"
BBFILE_PRIORITY_cmf-filogic = "24"

LAYERSERIES_COMPAT_cmf-filogic = "dunfell kirkstone"

require conf/distro/include/rdk-filogic.inc
#require conf/include/rdk-external-src-platform.inc
```

## meta-cmf-filogic/conf/machine/filogic830-32bit.conf
```bitbake
#@TYPE: Machine
#@NAME: mediatek filogic
#@NEEDED_BSPLAYERS: meta-filogic
#@DESCRIPTION: Machine configuration for running a RDK broadband on mediatek filogic
#@RDK_FLAVOR: rdkb

include conf/machine/filogic-32bit.conf

MACHINE_EXTRA_RRECOMMENDS += "kernel-modules"

MACHINE_IMAGE_NAME = "rdkb-generic-broadband-image"

MACHINEOVERRIDES .= ":broadband:filogic-32bit:mt7986-32bit"

PREFERRED_PROVIDER_u-boot-fw-utils = "libubootenv"

PREFERRED_VERSION_xfsprogs = "4.8.0"
PREFERRED_VERSION_php_dunfell = "7.1.%"
PREFERRED_VERSION_php-native_dunfell = "7.1.%"

PREFERRED_PROVIDER_virtual/kernel = "linux-mediatek"
PREFERRED_PROVIDER_virtual/bootloader = "u-boot"
PREFERRED_VERSION_linux-mediatek = "5.4.%"
PREFERRED_VERSION_linux-libc-headers = "5.4"

#masking files for dunfell build
require conf/include/filogic-bbmasks.inc
#require conf/include/rdk-external-src-platform.inc

DISTRO_FEATURES_append = " meshwifi"
DISTRO_FEATURES_append = " ipv6"
DISTRO_FEATURES_append = " kernel_in_ubi"
#DISTRO_FEATURES_append = " switch_gsw_mode"
DISTRO_FEATURES_append = " fwupgrade_manager"
DISTRO_FEATURES_append = " mt76"
DISTRO_FEATURES_append = " flow_offload"
#DISTRO_FEATURES_append = " logan"
#DISTRO_FEATURES_append = " mtk_easymesh"
# kernel 5.4 gold linker 'arm-rdk-linux-gnueabi-ld' not supported
#DISTRO_FEATURES_append = " referencepltfm "
#DISTRO_FEATURES_remove = " ld-is-gold"
BBMASK .= "|meta-filogic-logan/recipes-wifi/"
#for sdk support
INHERIT_append = " uninative"
BB_SETSCENE_ENFORCE_WHITELIST_append = " %:* *:do_fetch *"

BOOT_SUFFIX = "bin"
MACHINE_FEATURES = "ext2 ipsec nfs pci smbfs usbgadget usbhost vfat"
```

## meta-cmf-filogic/conf/machine/filogic860-logan-sdb-be3600-7988d-ccn34.conf
```bitbake
#@TYPE: Machine
#@NAME: mediatek filogic
#@NEEDED_BSPLAYERS: meta-filogic
#@DESCRIPTION: Machine configuration for running a RDK broadband on mediatek filogic
#@RDK_FLAVOR: rdkb

include conf/machine/filogic860-logan-sdb-be3600-7988d.conf

PREFERRED_VERSION_iproute2 = "6.7.0"

DISTRO_FEATURES_append = " ccn34"
DISTRO_FEATURES_append = " switch_gsw_mode"
DISTRO_FEATURES_append = " owl"
DISTRO_FEATURES_append = " eip-197-inline"
DISTRO_FEATURES_append = " capwap-dtls"
#DISTRO_FEATURES_append = " emmc"

DISTRO_FEATURES_remove = " meshwifi"
DISTRO_FEATURES_remove = " mtk_easymesh"
```

## meta-cmf-filogic/conf/machine/filogic860.conf
```bitbake
#@TYPE: Machine
#@NAME: mediatek filogic
#@NEEDED_BSPLAYERS: meta-filogic
#@DESCRIPTION: Machine configuration for running a RDK broadband on mediatek filogic
#@RDK_FLAVOR: rdkb

include conf/machine/filogic.conf

MACHINE_EXTRA_RRECOMMENDS += "kernel-modules"

MACHINE_IMAGE_NAME = "rdkb-generic-broadband-image"

MACHINEOVERRIDES .= ":broadband:filogic:mt7988:mt7990:mt7988d"

PREFERRED_PROVIDER_u-boot-fw-utils = "libubootenv"

PREFERRED_VERSION_xfsprogs = "4.8.0"
PREFERRED_VERSION_php_dunfell = "7.1.%"
PREFERRED_VERSION_php-native_dunfell = "7.1.%"

PREFERRED_PROVIDER_virtual/kernel = "linux-mediatek"
PREFERRED_PROVIDER_virtual/bootloader = "u-boot"
PREFERRED_VERSION_linux-mediatek = "5.4.%"
PREFERRED_VERSION_linux-libc-headers = "5.4"

PREFERRED_PROVIDER_hal-wifi = "hal-wifi-mt76"
PREFERRED_VERSION_iw_filogic = "6.%"
PREFERRED_VERSION_lua = "5.3.%"
#wifi bsp from openwrt
#PREFERRED_VERSION_hostapd = "2.11"
#PREFERRED_VERSION_wpa-supplicant = "2.11"
PREFERRED_VERSION_linux-mac80211 = "6.%"
PREFERRED_VERSION_linux-mt76 = "3.%"
PREFERRED_VERSION_hostapd = "2.10.3"
PREFERRED_VERSION_wpa-supplicant_filogic = "2.10.3"
PREFERRED_VERSION_json-c = "0.15"
#PREFERRED_VERSION_linux-mac80211 = "5.15.%"
#PREFERRED_VERSION_linux-mt76 = "2.%"

#masking files for dunfell build
require conf/include/filogic-bbmasks.inc
#require conf/include/rdk-external-src-platform.inc

DISTRO_FEATURES_append = " meshwifi"
DISTRO_FEATURES_append = " ipv6"
DISTRO_FEATURES_append = " kernel_in_ubi"
#DISTRO_FEATURES_append = " switch_gsw_mode"
DISTRO_FEATURES_append = " fwupgrade_manager"
DISTRO_FEATURES_append = " mt76"
DISTRO_FEATURES_append = " flow_offload"
DISTRO_FEATURES_append = " wifi_eht"
#DISTRO_FEATURES_append = " logan"
#DISTRO_FEATURES_append = " mtk_easymesh"
# kernel 5.4 gold linker 'arm-rdk-linux-gnueabi-ld' not supported
#DISTRO_FEATURES_append = " referencepltfm "
#DISTRO_FEATURES_remove = " ld-is-gold"
BBMASK .= "|meta-filogic-logan/recipes-wifi/"
#for sdk support
INHERIT_append = " uninative"

BOOT_SUFFIX = "bin"
MACHINE_FEATURES = "ext2 ipsec nfs pci smbfs usbgadget usbhost vfat"

#for secure boot support
#DISTRO_FEATURES_append = " secure_boot"
MACHINEOVERRIDES .="${@bb.utils.contains('DISTRO_FEATURES','secure_boot',':secureboot','',d)}"
SECURE_BOOT_KEYNAME_secureboot = "fit_key"
SECURE_BOOT_KEYDIR_secureboot = "${TOPDIR}/../keys"
FIT_HASH_ALG_secureboot ="sha1"
HASHED_BOOT_DEVICE_secureboot = "252:0"

# for efuse tools
#DISTRO_FEATURES_append = " efuse_tools"
```

## meta-cmf-filogic/conf/machine/filogic880-logan-be7200-2023q2.conf
```bitbake
#@TYPE: Machine
#@NAME: mediatek filogic
#@NEEDED_BSPLAYERS: meta-filogic
#@DESCRIPTION: Machine configuration for running a RDK broadband on mediatek filogic
#@RDK_FLAVOR: rdkb

include conf/machine/filogic.conf

MACHINE_EXTRA_RRECOMMENDS += "kernel-modules"

MACHINE_IMAGE_NAME = "rdkb-generic-broadband-image"

MACHINEOVERRIDES .= ":broadband:filogic:mt7988"

PREFERRED_PROVIDER_u-boot-fw-utils = "libubootenv"

PREFERRED_VERSION_xfsprogs = "4.8.0"
PREFERRED_VERSION_php_dunfell = "7.1.%"
PREFERRED_VERSION_php-native_dunfell = "7.1.%"

PREFERRED_PROVIDER_virtual/kernel = "linux-mediatek"
PREFERRED_PROVIDER_virtual/bootloader = "u-boot"
PREFERRED_VERSION_linux-mediatek = "5.4.%"
PREFERRED_VERSION_linux-libc-headers = "5.4"

PREFERRED_PROVIDER_hal-wifi = "hal-wifi-logan"
PREFERRED_VERSION_iw_filogic = "5.%"
#wifi bsp from openwrt
PREFERRED_VERSION_hostapd = "2.10"
PREFERRED_VERSION_wpa-supplicant = "2.10"


#masking files for dunfell build
require conf/include/filogic-bbmasks.inc
#require conf/include/rdk-external-src-platform.inc

DISTRO_FEATURES_append = " meshwifi"
DISTRO_FEATURES_append = " ipv6"
DISTRO_FEATURES_append = " kernel_in_ubi"
#DISTRO_FEATURES_append = " switch_gsw_mode"
DISTRO_FEATURES_append = " fwupgrade_manager"
#DISTRO_FEATURES_append = " mt76"
#DISTRO_FEATURES_append = " flow_offload"
DISTRO_FEATURES_append = " logan"
DISTRO_FEATURES_append = " mtk_easymesh"
# kernel 5.4 gold linker 'arm-rdk-linux-gnueabi-ld' not supported
#DISTRO_FEATURES_append = " referencepltfm "
#DISTRO_FEATURES_remove = " ld-is-gold"

DISTRO_FEATURES_append = " 2023q2_support"

DISTRO_FEATURES_append = " kite"

BBMASK .= "|meta-filogic/recipes-wifi/"

#for mt7992-be7200
DISTRO_FEATURES_append = " mt7992-be7200"
MACHINEOVERRIDES .="${@bb.utils.contains('DISTRO_FEATURES','mt7992-be7200',':mt7992-be7200','',d)}"
#for sdk support
INHERIT_append = " uninative"
BB_SETSCENE_ENFORCE_WHITELIST_append = " %:* *:do_fetch *"

BOOT_SUFFIX = "bin"
MACHINE_FEATURES = "ext2 ipsec nfs pci smbfs usbgadget usbhost vfat"

#for secure boot support
#DISTRO_FEATURES_append = " secure_boot"
MACHINEOVERRIDES .="${@bb.utils.contains('DISTRO_FEATURES','secure_boot',':secureboot','',d)}"
SECURE_BOOT_KEYNAME_secureboot = "fit_key"
SECURE_BOOT_KEYDIR_secureboot = "${TOPDIR}/../keys"
FIT_HASH_ALG_secureboot ="sha1"
HASHED_BOOT_DEVICE_secureboot = "252:0"
```

## meta-cmf-filogic/conf/machine/filogic880-logan-be7200-ccn34.conf
```bitbake
#@TYPE: Machine
#@NAME: mediatek filogic
#@NEEDED_BSPLAYERS: meta-filogic
#@DESCRIPTION: Machine configuration for running a RDK broadband on mediatek filogic
#@RDK_FLAVOR: rdkb

include conf/machine/filogic.conf
include conf/machine/filogic880-logan-be7200.conf

DISTRO_FEATURES_append = " ccn34"
DISTRO_FEATURES_remove = " meshwifi"
DISTRO_FEATURES_remove = " mtk_easymesh"
DISTRO_FEATURES_append = " switch_gsw_mode"
```

## meta-cmf-filogic/conf/machine/filogic880-logan_2022q3-ccn34.conf
```bitbake
#@TYPE: Machine
#@NAME: mediatek filogic
#@NEEDED_BSPLAYERS: meta-filogic
#@DESCRIPTION: Machine configuration for running a RDK broadband on mediatek filogic
#@RDK_FLAVOR: rdkb

include conf/machine/filogic.conf
include conf/machine/filogic880-logan_2022q3.conf

PREFERRED_VERSION_iproute2 = "6.7.0"

DISTRO_FEATURES_append = " ccn34"
DISTRO_FEATURES_append = " eagle"
DISTRO_FEATURES_append = " owl"
DISTRO_FEATURES_remove = " meshwifi"
DISTRO_FEATURES_remove = " mtk_easymesh"
DISTRO_FEATURES_append = " switch_gsw_mode"
DISTRO_FEATURES_append = " eip-197-inline"
DISTRO_FEATURES_append = " capwap-dtls"
```

## meta-cmf-filogic/conf/machine/include/tune-cortexa7-soft.inc
```bitbake
DEFAULTTUNE = "cortexa7-soft"

AVAILTUNES += "cortexa7-soft"

require conf/machine/include/tune-cortexa7.inc

TUNEVALID[fpu-soft] = "Use software FPU."
TUNE_CCARGS .= "${@bb.utils.contains('TUNE_FEATURES', 'fpu-soft', ' -msoft-float', '', d)}"
TARGET_FPU = "${@bb.utils.contains('TUNE_FEATURES', 'fpu-soft', 'soft', '', d)}"

# Basic tune definitions
ARMPKGARCH_tune-cortexa7-soft = "cortexa7"
TUNE_FEATURES_tune-cortexa7-soft = "${TUNE_FEATURES_tune-cortexa7} fpu-soft"
PACKAGE_EXTRA_ARCHS_tune-cortexa7-soft  = "${PACKAGE_EXTRA_ARCHS_tune-armv7ve} cortexa7-vfp fpu-soft"
```

## meta-cmf-raspberrypi/conf/machine/raspberrypi4-64-rdk-android-ipmc.conf
```bitbake
#@TYPE: Machine
#@NAME: raspberrypi4-64-rdk-android-ipmc
#@NEEDED_BSPLAYERS: meta-raspberrypi
#@DESCRIPTION: Machine configuration for running a RDK IP client (STB) on 64bit android kernel on Raspberry Pi4
#@RDK_FLAVOR: rdkv

require  raspberrypi4-64-rdk-ipmc.conf
require  raspberrypi4-64-rdk-multilib.conf

PREFERRED_PROVIDER_virtual/kernel = "android-raspberrypi"
```

## meta-cmf-raspberrypi/conf/machine/raspberrypi4-64-rdk-ipmc.conf
```bitbake
#@TYPE: Machine
#@NAME: raspberrypi4-64-rdk-ipmc
#@NEEDED_BSPLAYERS: meta-raspberrypi
#@DESCRIPTION: Machine configuration for running a RDK IP client (STB) on Raspberry Pi 4 
#@RDK_FLAVOR: rdkv

require conf/machine/raspberrypi4-64.conf

MACHINEOVERRIDES .= ":raspberrypi4-64:rpi:client:wpe:ipclient:lxcsecure"

# this can be removed if cc is open sourced
CLOSEDCAPTION = ""

# required for image creation
MACHINE_IMAGE_NAME = "rdk-generic-ip-stb-client-wpe-image"

# to enable hdmi_hotplug
ENABLE_HDMI_FORCE_HOTPLUG = "1"
```

## meta-cmf/conf/distro/include/rdk-versions.inc
```bitbake
#
# root location of Generic RDK components
RDK_GENERIC_ROOT_SVN ?= "svn5.teamccp.com/svn/rdk/components/generic"
RDK_GIT ?= "gerrit.teamccp.com"
RDK_GIT_PROTOCOL ?= "https"
RDK_GENERIC_ROOT_GIT ?= "git://${RDK_GIT}/rdk/components/generic"
RDK_COMPONENTS_ROOT_GIT ?= "git://${RDK_GIT}/rdk/components"
RDKB_COMPONENTS_ROOT_GIT ?= "git://${RDK_GIT}/rdk/rdkb/components"
RDKB_CCSP_ROOT_GIT ?= "git://${RDK_GIT}/rdk/rdkb/components/opensource/ccsp"
RDK_GIT_BRANCH ?= "rdkb-2024q1-kirkstone"
CCSP_GIT_BRANCH ?= "rdkb-2024q1-kirkstone"
PROJECT_BRANCH ?= "default"

CMF_GIT_ROOT ?= "git://code.rdkcentral.com/r"
CMF_GITHUB_ROOT ?= "git://github.com/rdkcentral"
CMF_GIT_PROTOCOL ?= "https"
CMF_RDK_COMPONENTS_ROOT_GIT ?= "${CMF_GIT_ROOT}/rdk/components"
CMF_RDKB_COMPONENTS_ROOT_GIT ?= "${CMF_GIT_ROOT}/rdkb/components"
CMF_RDKB_CCSP_ROOT_GIT ?= "${CMF_RDKB_COMPONENTS_ROOT_GIT}/opensource/ccsp"

CMF_GIT_BRANCH ?= "rdkb-2024q1-kirkstone"
CMF_GIT_MAIN_BRANCH ?= "rdkb-2024q1-kirkstone"
CMF_GIT_MASTER_BRANCH ?= "rdkb-2024q1-kirkstone"
CMF_GITHUB_MAIN_BRANCH ?= "rdkb-2024q1-kirkstone"
CMF_GITHUB_MASTER_BRANCH ?= "rdkb-2024q1-kirkstone"
CMF_GITHUB_RELEASE_BRANCH ?= "rdkb-2024q1-kirkstone"
CMF_GITHUB_STABLE2_BRANCH ?= "rdkb-2024q1-kirkstone"
CMF_GITHUB_RBUS_BRANCH ?= "rdkb-2024q1-kirkstone"
PROJECT_BRANCH = "${@d.getVar("CMF_GIT_BRANCH").replace('/','-')}"

RDK_RELEASE ?= "rdkb-2024q1-kirkstone"
RELEASE_VERSION = "${@time.strftime("${RDK_RELEASE}.%m.%d.%y",time.gmtime())}"
```

## meta-cmf/conf/distro/include/rdkcmf.inc
```bitbake
BBMASK .= "|meta-rdk/recipes-extended/jquery/"

MAINTAINER = "RDK CMF Team <support@rdkcentral.com>"

PREFERRED_PROVIDER_curl ?= "curl"

# Revert meta-rdk/+/73763 RDKTV-17032: Build failure due to compiler out of memory
# It is causing race condition issues in build
PARALLEL_MAKE_remove = " -l ${@int(os.sysconf(os.sysconf_names['SC_NPROCESSORS_ONLN'])) * 150/100}"

# Add mixed mode support in addition to the list in
# meta-rdk/conf/distro/include/license_flags_whitelist.inc
require ${@bb.utils.contains_any('DISTRO_FEATURES','dunfell morty daisy','license_flags_whitelist.inc','license_flags_accepted.inc',d)}
```
