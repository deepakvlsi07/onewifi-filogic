## meta-cmf/conf/layer.conf
```bitbake
BBPATH .= ":${LAYERDIR}"

BBFILES += "\
            ${LAYERDIR}/recipes-*/*/*.bb \
            ${LAYERDIR}/recipes-*/*/*/*.bb \
            ${LAYERDIR}/recipes-*/*/*.bbappend \
            ${LAYERDIR}/recipes-*/*/*/*.bbappend \
           "

BBFILE_COLLECTIONS += "cmf"
BBFILE_PATTERN_cmf := "^${LAYERDIR}/"
#BBFILE_PRIORITY_cmf = "25"

LAYERSERIES_COMPAT_cmf = "dunfell kirkstone"

# Additional license directories.
LICENSE_PATH += "${LAYERDIR}/licenses"

LAYERDEPENDS_cmf = "rdk"

RDK_ROOT_PATH = "${LAYERDIR}/.."

require conf/distro/include/rdkcmf.inc
require conf/distro/include/rdk-external-src.inc
require conf/distro/include/rdk-versions.inc

PREFERRED_PROVIDER_virtual/samplemedia ?= "linaro-samplemedia"
PREFERRED_VERSION_lighttpd = "1.4.39"

#Temporary bbmasks for components that have not been opensourced yet
BBMASK .= "|meta-rdk/recipes-common/rdk-scheduler/"
BBMASK .= "|meta-rdk/recipes-support/rbusmirrors/"
BBMASK .= "|meta-rdk/recipes-support/rbustools/"
BBMASK .= "|meta-rdk-video/recipes-extended/clnl/"
BBMASK .= "|meta-rdk-video/recipes-extended/ctrlm/ctrlm-factory.bb"
BBMASK .= "|meta-rdk-video/recipes-extended/ctrlm/ctrlm-factory-headers.bb"
BBMASK .= "|meta-rdk-video/recipes-extended/thunderstartupservices/"
BBMASK .= "|meta-rdk-broadband/recipes-ccsp/ccsp/batterymgr.bb"
BBMASK .= "|meta-rdk-broadband/recipes-ccsp/ccsp/lanmanager.bb"
BBMASK .= "|meta-rdk-broadband/recipes-ccsp/ccsp/rfc-agent.bb"
BBMASK .= "|meta-rdk-broadband/recipes-ccsp/ccsp/platformmanager.bb"
BBMASK .= "|meta-rdk-broadband/recipes-ccsp/ccsp/gatewaymanager.bb"
BBMASK .= "|meta-rdk-camera/recipes-extended/video-analytics/"
BBMASK .= "|meta-rdk-camera/recipes-multimedia/rtc-signaling/"

# The linux-libc-headers recipe in meta-rdk-ext is for a specific Comcast platform
# and not applicable to CMF platforms
BBMASK_append_morty .= "|meta-rdk-ext/recipes-kernel/linux/linux-libc-headers_3.14.bb"

# Masking the duplicate googletest recipe in meta-rdk-ext. Use the one in
# meta-openembedded
BBMASK .= "|meta-rdk-ext/recipes-test/googletest/"

# Masking recipes for deprecated components
BBMASK += "|meta-rdk-restricted/recipes-qt/servicemanager/"
BBMASK += "|meta-rdk-restricted/recipes-qt/servicemanagerfunctionaltest/"
BBMASK += "|meta-rdk-restricted/recipes-qt/rdkbrowser/"
BBMASK += "|meta-rdk-restricted/recipes-extended/podmgr/"
#BBMASK_append_ipclient = " |meta-rdk-video/recipes-extended/asbluetoothrcu/"
BBMASK += "|meta-rdk-video/recipes-extended/mediaframework/runpod_git.bb"
BBMASK += "|meta-rdk-video/recipes-extended/mediaframework/rmfpodmgr_git.bb"
BBMASK += "|meta-rdk-video/recipes-extended/mediaframework/rmfpodmgrheaders_git.bb"
BBMASK += "|meta-rdk-video/recipes-extended/mediaframework/rmfpodserver_git.bb"
#BBMASK_append_ipclient = " |meta-rdk-video/recipes-extended/trm/qtapp_git.bb"
#BBMASK_append_ipclient = " |meta-rdk-video/recipes-extended/trm/wsproxy_git.bb"
#BBMASK_append_ipclient = " |meta-rdk/recipes-core/packagegroups/packagegroup-rdk-qt5.bb"
#BBMASK_append_ipclient = " |meta-rdk/recipes-qt/qt5/"
BBMASK += "|meta-rdk-ext/recipes-extended/libqjson/"

DISTRO_FEATURES_append_arm = " ld-is-gold"
DISTRO_FEATURES_append_x86 = " ld-is-gold"
DISTRO_FEATURES_append = " virtualization"

DISTRO_FEATURES_append_dunfell = " dunfell"
DISTRO_FEATURES_append_kirkstone = " kirkstone"

DISTRO_FEATURES_append_dunfell = " ssl-1.1.1"

PREFERRED_VERSION_xfsprogs_morty = "4.8.0"
PREFERRED_VERSION_xfsprogs_dunfell = "5.2.1"

# Masking the below recipes because in kirkstone build recipes pulling older version due to layer priority
BBMASK .= "${@bb.utils.contains('DISTRO_FEATURES', 'kirkstone', '|.meta-rdk-ext/recipes-devtools/jsonrpc/jsonrpc_0.7.0.bb', '', d)}"
```

## meta-gplv2/conf/distro/include/disable-gplv3.inc
```bitbake
INCOMPATIBLE_LICENSE = 'LGPL-3.0* GPL-3.0*'
WARN_QA:remove = 'incompatible-license'
RDEPENDS:${PN}-ptest:remove:pn-glib-2.0 = "python3-dbusmock"
DISTRO_FEATURES:remove = "ptest"
```

## meta-rdk-ext/conf/layer.conf
```bitbake
BBPATH .= ":${LAYERDIR}"

BBFILES += "\
            ${LAYERDIR}/recipes-*/*/*.bb \
            ${@bb.utils.contains('DISTRO_FEATURES', 'gstreamer1_18',' ${LAYERDIR}/recipes-*/*/*/*.bb ${LAYERDIR}/recipes-*/*/*/*.bbappend ','',d)} \
            ${LAYERDIR}/recipes-*/*/*.bbappend \
           "

BBFILE_COLLECTIONS += "rdk-ext"
BBFILE_PATTERN_rdk-ext := "^${LAYERDIR}/"
BBFILE_PRIORITY_rdk-ext = "6"

LAYERSERIES_COMPAT_rdk-ext = "zeus dunfell kirkstone"

LAYERDEPENDS_rdk-ext = "multimedia-layer"

require conf/distro/include/rdk_ext_lto.inc
require conf/include/rdk-bbmasks-ext.inc

BBMASK .= "${@bb.utils.contains('DISTRO_FEATURES', 'gstreamer1_18', '', "|meta-rdk-ext/recipes-devtools/orc/orc_0.4.31.bb", d)}"
BBMASK .= "${@bb.utils.contains('DISTRO_FEATURES', 'gstreamer1_18', '', "|meta-rdk-ext/recipes-multimedia/gstreamer/gstreamer1.0_1.14.1.bb", d)}"
BBMASK .= "${@bb.utils.contains('DISTRO_FEATURES', 'gstreamer1_18', '', "|meta-rdk-ext/recipes-multimedia/gstreamer/gstreamer1.0_1.14.1.bbappend", d)}"
BBMASK .= "${@bb.utils.contains('DISTRO_FEATURES', 'gstreamer1_18', '', "|meta-rdk-ext/recipes-multimedia/gstreamer/gstreamer1.0-plugins-base_1.14.1.bb", d)}"
BBMASK .= "${@bb.utils.contains('DISTRO_FEATURES', 'gstreamer1_18', '', "|meta-rdk-ext/recipes-multimedia/gstreamer/gstreamer1.0-plugins-good_1.14.1.bb", d)}"
BBMASK .= "${@bb.utils.contains('DISTRO_FEATURES', 'gstreamer1_18', '', "|meta-rdk-ext/recipes-multimedia/gstreamer/gstreamer1.0-plugins-bad_1.14.1.bb", d)}"
BBMASK .= "${@bb.utils.contains('DISTRO_FEATURES', 'gstreamer1_18', '', "|meta-rdk-ext/recipes-multimedia/gstreamer/gstreamer1.0-omx_1.14.1.bb", d)}"
BBMASK .= "${@bb.utils.contains('DISTRO_FEATURES', 'gstreamer1_18', '', "|meta-rdk-ext/recipes-multimedia/gstreamer/gstreamer1.0-libav_1.14.1.bb", d)}"

BBMASK .= "${@bb.utils.contains('DISTRO_FEATURES', 'wpe-2.38', '', '|meta-rdk-ext/recipes-extended/wpe-webkit/wpe-webkit_2.38.*', d)}"

BBMASK .= "${@bb.utils.contains('DISTRO_FEATURES', 'enable_libsoup3', '|meta-rdk-ext/recipes-core/glib-networking/glib-networking_2.48.*', '', d)}"

BBMASK .= "${@bb.utils.contains('DISTRO_FEATURES', 'dunfell', '', '|meta-rdk-ext/recipes-extended/cog/cog_0.16.*', d)}"

# bbappend files to enable AddressSanitizer for some modules
BBMASK .= "${@bb.utils.contains('DISTRO_FEATURES', 'enable_asan', '', '|meta-rdk-ext/recipes-devtools/asan/*', d)}"
```

## meta-rdk/conf/distro/include/rdk-versions.inc
```bitbake
#
# root location of Generic RDK components
RDK_ARTIFACTS_BASE_URL ?= "https://partners.artifactory.comcast.com/artifactory"
RDK_ARTIFACTS_URL ?= "partners.artifactory.comcast.com/artifactory"
RDK_GENERIC_ROOT_SVN ?= "svn5.teamccp.com/svn/rdk/components/generic"
RDK_GIT ?= "gerrit.teamccp.com:29418"
CMF_GIT_ROOT ?= "git://code.rdkcentral.com/r"
RBUS_RDKCENTRAL_GIT ?= "https://github.com/rdkcentral/rbus.git"
RDK_GIT_PROTOCOL ?= "ssh"
RDK_RELEASE ?= "1.99"
RDK_GENERIC_ROOT_GIT ?= "git://${RDK_GIT}/rdk/components/generic"
RDK_COMPONENTS_ROOT_GIT ?= "git://${RDK_GIT}/rdk/components"
RDKB_COMPONENTS_ROOT_GIT ?= "git://${RDK_GIT}/rdk/rdkb/components"
RDKB_CCSP_ROOT_GIT ?= "git://${RDK_GIT}/rdk/rdkb/components/opensource/ccsp"
RDKB_COMPONENTS_OS_GIT ?= "git://${RDK_GIT}/rdk/components/opensource"
RDK_GIT_BRANCH ?= "stable2"
CCSP_GIT_BRANCH ?= "stable2"
PROJECT_BRANCH ?= "default"

CMF_GIT_ROOT ?= "git://code.rdkcentral.com/r"
CMF_GIT_PROTOCOL ?= "https"
CMF_RDK_COMPONENTS_ROOT_GIT ?= "${CMF_GIT_ROOT}/rdk/components"
CMF_RDKB_COMPONENTS_ROOT_GIT ?= "${CMF_GIT_ROOT}/rdkb/components"
CMF_RDKB_CCSP_ROOT_GIT ?= "${CMF_RDKB_COMPONENTS_ROOT_GIT}/opensource/ccsp"
CMF_GIT_BRANCH ?= "rdk-next"
CMF_GIT_MASTER_BRANCH ?= "master"

CMF_GITHUB_ROOT ?= "git://github.com/rdkcentral"
CMF_GITHUB_MAIN_BRANCH ?= "main"
CMF_GITHUB_MASTER_BRANCH ?= "master"
CMF_GITHUB_STABLE2_BRANCH ?= "stable2"

SRCREV_pn-devicesettings ?= "${AUTOREV}"
SRCREV_pn-devicesettings-hal-headers ?= "${SRCREV_pn-devicesettings}"
SRCREV_pn-devicesettings-hal-noop ?= "${AUTOREV}"
SRCREV_pn-dtcpmgr-noop ?= "${AUTOREV}"
SRCREV_pn-sectionfilter-hal-noop ?= "${AUTOREV}"
SRCREV_pn-gst-plugins-rdk ?= "${AUTOREV}"
SRCREV_pn-iarmbus ?= "${AUTOREV}"
SRCREV_pn-iarmmgrs ?= "${AUTOREV}"
SRCREV_pn-iarmmgrs-hal-headers ?= "${SRCREV_pn-iarmmgrs}"
SRCREV_pn-iarmmgrs-hal-noop ?= "${AUTOREV}"
SRCREV_pn-rdk-diagnostics ?= "${AUTOREV}"
SRCREV_pn-diagnostics-snmp2json ?= "${AUTOREV}"
SRCREV_pn-rdk-logger ?= "${AUTOREV}"
SRCREV_pn-rdkbrowser ?= "${AUTOREV}"
SRCREV_pn-rmfstreamer ?= "${AUTOREV}"
SRCREV_pn-rmfapp ?= "${AUTOREV}"
SRCREV_pn-rmfhalheaders ?= "${AUTOREV}"
SRCREV_pn-rmfgeneric ?= "${AUTOREV}"
SRCREV_pn-trm-common ?= "${AUTOREV}"
SRCREV_pn-wsproxy ?= "${AUTOREV}"
SRCREV_pn-qtapp ?= "${AUTOREV}"
SRCREV_pn-xupnp ?= "${AUTOREV}"
SRCREV_pn-tr69hostif ?= "${AUTOREV}"
SRCREV_pn-sysint ?= "${AUTOREV}"
SRCREV_pn-vodclient-app ?= "${AUTOREV}"
SRCREV_pn-vodclient-java ?= "${AUTOREV}"
SRCREV_pn-secapi ?= "${AUTOREV}"
SRCREV_pn-authservice ?= "${AUTOREV}"
SRCREV_pn-cachehelpers ?= "${AUTOREV}"
SRCREV_pn-hdmicec ?= "${AUTOREV}"
SRCREV_pn-hdmicecheader ?= "${AUTOREV}"
SRCREV_pn-tr69hostif-headers ?= "${AUTOREV}"
SRCREV_pn-rmfbase ?= "${AUTOREV}"
SRCREV_pn-rmfosal ?= "${AUTOREV}"
SRCREV_pn-trh ?= "${AUTOREV}"
```

## meta-rdk/conf/distro/include/rdk_backtrace_log.inc
```bitbake
# backtrace logging is enabled
# we set this to "y" or "n" and use it as a conditional later

LOG_BACKTRACE = "${@bb.utils.contains('DISTRO_FEATURES', 'logbacktrace', 'y', 'n', d)}"

BACKTRACE_LDFLAGS ?= ""
BACKTRACE_DEPENDS ?= ""

BACKTRACE_DEPENDS_pn-iarmbus = " breakpad-wrapper"
BACKTRACE_DEPENDS_pn-iarmmgrs = " breakpad-wrapper"
BACKTRACE_DEPENDS_pn-rmfstreamer = " breakpad-wrapper"
BACKTRACE_DEPENDS_pn-rmfpodmgr = " breakpad-wrapper"
BACKTRACE_DEPENDS_pn-parodus = " breakpad-wrapper"
BACKTRACE_DEPENDS_pn-tr69hostif = " breakpad-wrapper"
BACKTRACE_DEPENDS_pn-wpeframework = " breakpad-wrapper"
BACKTRACE_DEPENDS_pn-wpa-supplicant = " breakpad-wrapper"
BACKTRACE_DEPENDS_pn-hdmicec = " breakpad-wrapper"
BACKTRACE_DEPENDS_pn-devicesettings = " breakpad-wrapper"
BACKTRACE_DEPENDS_pn-trmmgr = " breakpad-wrapper"
BACKTRACE_DEPENDS_pn-wsproxy = " breakpad-wrapper"
BACKTRACE_DEPENDS_pn-qtapp = " breakpad-wrapper"
BACKTRACE_DEPENDS_pn-ledmgr = " breakpad-wrapper"
BACKTRACE_DEPENDS_pn-audiocapturemgr = " breakpad-wrapper"
BACKTRACE_DEPENDS_pn-audioserver = " breakpad-wrapper"
BACKTRACE_DEPENDS_pn-audioserver-soc = " breakpad-wrapper"
BACKTRACE_DEPENDS_pn-runpod = " breakpad-wrapper"
BACKTRACE_DEPENDS_pn-runsnmp = " breakpad-wrapper"
BACKTRACE_DEPENDS_pn-vodclient-app = " breakpad-wrapper"
BACKTRACE_DEPENDS_pn-nlmon = " breakpad-wrapper"
BACKTRACE_DEPENDS_pn-pwr-state-monitor = " breakpad-wrapper"
BACKTRACE_DEPENDS_pn-authservice = " breakpad-wrapper"
BACKTRACE_DEPENDS_pn-aml-audio-service = " breakpad-wrapper"
BACKTRACE_DEPENDS_pn-asbluetoothrcu  = " breakpad-wrapper"
BACKTRACE_DEPENDS_pn-dnsmasq = " breakpad-wrapper"
BACKTRACE_DEPENDS_pn-rdkfwupgrader = " breakpad-wrapper"
BACKTRACE_DEPENDS_pn-cobaltlauncher = " breakpad-wrapper"
BACKTRACE_DEPENDS_pn-libloader-app = " breakpad-wrapper"

BACKTRACE_LDFLAGS_pn-iarmbus = " -Wl,--no-as-needed -lbreakpadwrapper -Wl,--as-needed "
BACKTRACE_LDFLAGS_pn-iarmmgrs = " -lbreakpadwrapper "
BACKTRACE_LDFLAGS_pn-rmfstreamer = " -lbreakpadwrapper "
BACKTRACE_LDFLAGS_pn-rmfpodmgr = " -lbreakpadwrapper "
BACKTRACE_LDFLAGS_pn-parodus = " -Wl,--no-as-needed -lbreakpadwrapper -Wl,--as-needed "
BACKTRACE_LDFLAGS_pn-tr69hostif = " -Wl,--no-as-needed -lbreakpadwrapper -Wl,--as-needed "
BACKTRACE_LDFLAGS_pn-rdkservices = " -Wl,--no-as-needed -lbreakpadwrapper -Wl,--as-needed "
BACKTRACE_LDFLAGS_pn-webkitbrowser-plugin = " -Wl,--no-as-needed -lbreakpadwrapper -Wl,--as-needed "
BACKTRACE_LDFLAGS_pn-cobalt-plugin = " -Wl,--no-as-needed -lbreakpadwrapper -Wl,--as-needed "
BACKTRACE_LDFLAGS_pn-browserlauncher = " -Wl,--no-as-needed -lbreakpadwrapper -Wl,--as-needed "
BACKTRACE_LDFLAGS_pn-wpeframework-plugin-netflix = " -Wl,--no-as-needed -lbreakpadwrapper -Wl,--as-needed "
BACKTRACE_LDFLAGS_pn-wpa-supplicant = " -Wl,--no-as-needed -lbreakpadwrapper -Wl,--as-needed "
BACKTRACE_LDFLAGS_pn-hdmicec = " -Wl,--no-as-needed -lbreakpadwrapper -Wl,--as-needed "
BACKTRACE_LDFLAGS_pn-devicesettings = " -Wl,--no-as-needed -lbreakpadwrapper -Wl,--as-needed "
BACKTRACE_LDFLAGS_pn-trmmgr = " -Wl,--no-as-needed -lbreakpadwrapper -Wl,--as-needed "
BACKTRACE_LDFLAGS_pn-wsproxy = " -Wl,--no-as-needed -lbreakpadwrapper -Wl,--as-needed "
BACKTRACE_LDFLAGS_pn-qtapp = " -Wl,--no-as-needed -lbreakpadwrapper -Wl,--as-needed "
BACKTRACE_LDFLAGS_pn-ledmgr = " -Wl,--no-as-needed -lbreakpadwrapper -Wl,--as-needed "
BACKTRACE_LDFLAGS_pn-audiocapturemgr = " -Wl,--no-as-needed -lbreakpadwrapper -Wl,--as-needed "
BACKTRACE_LDFLAGS_pn-audioserver = " -Wl,--no-as-needed -lbreakpadwrapper -Wl,--as-needed "
BACKTRACE_LDFLAGS_pn-audioserver-soc= " -Wl,--no-as-needed -lbreakpadwrapper -Wl,--as-needed "
BACKTRACE_LDFLAGS_pn-runpod = " -Wl,--no-as-needed -lbreakpadwrapper -Wl,--as-needed "
BACKTRACE_LDFLAGS_pn-runsnmp = " -Wl,--no-as-needed -lbreakpadwrapper -Wl,--as-needed "
BACKTRACE_LDFLAGS_pn-vodclient-app = " -Wl,--no-as-needed -lbreakpadwrapper -Wl,--as-needed "
BACKTRACE_LDFLAGS_pn-nlmon = " -Wl,--no-as-needed -lbreakpadwrapper -Wl,--as-needed "
BACKTRACE_LDFLAGS_pn-pwr-state-monitor = " -Wl,--no-as-needed -lbreakpadwrapper -Wl,--as-needed "
BACKTRACE_LDFLAGS_pn-authservice = " -Wl,--no-as-needed -lbreakpadwrapper -Wl,--as-needed "
BACKTRACE_LDFLAGS_pn-aml-audio-service = " -Wl,--no-as-needed -lbreakpadwrapper -Wl,--as-needed "
BACKTRACE_LDFLAGS_pn-asbluetoothrcu  = " -Wl,--no-as-needed -lbreakpadwrapper -Wl,--as-needed "
BACKTRACE_LDFLAGS_pn-dnsmasq = " -Wl,--no-as-needed -lbreakpadwrapper -Wl,--as-needed "
BACKTRACE_LDFLAGS_pn-rdkfwupgrader = " -Wl,--no-as-needed -lbreakpadwrapper -Wl,--as-needed "
BACKTRACE_LDFLAGS_pn-libloader-app = " -Wl,--no-as-needed -lbreakpadwrapper -Wl,--as-needed "

BACKTRACE_DEPENDS_pn-busybox = " crashlog"
BACKTRACE_DEPENDS_pn-lighttpd = " crashlog"

BACKTRACE_LDFLAGS_pn-busybox = " -Wl,--no-as-needed -lcrashlog -Wl,--as-needed"
BACKTRACE_LDFLAGS_pn-lighttpd = " -Wl,--no-as-needed -lcrashlog -Wl,--as-needed"
BACKTRACE_LDFLAGS_pn-cobaltlauncher = " -Wl,--no-as-needed -lbreakpadwrapper -Wl,--as-needed "

DEPENDS_append = " ${@LOG_BACKTRACE == "y" and BACKTRACE_DEPENDS or ""}"
LDFLAGS_append = " ${@LOG_BACKTRACE == "y" and BACKTRACE_LDFLAGS or ""}"
```
